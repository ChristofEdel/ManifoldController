## sdkconfig.defaults
```kconfig
CONFIG_AUTOSTART_ARDUINO=y
CONFIG_FREERTOS_HZ=1000
CONFIG_MBEDTLS_PSK_MODES=y
CONFIG_MBEDTLS_KEY_EXCHANGE_PSK=y
CONFIG_ESPTOOLPY_FLASHSIZE="16MB"
#
# TLS options so we can talk to the heatmiser hub which uses 
# self-signed certificates
#
CONFIG_ESP_TLS_INSECURE=y
CONFIG_ESP_TLS_SKIP_SERVER_CERT_VERIFY=y
#
# Long file name support
#
CONFIG_FATFS_LFN_HEAP=y
CONFIG_FATFS_MAX_LFN=255
CONFIG_FATFS_API_ENCODING_ANSI_OEM=y
#
# Task watchdog configuration
#
CONFIG_ESP_TASK_WDT_ISR_HANDLER=y
CONFIG_ESP_TASK_WDT_PANIC=y
#
# For debugging:
#
CONFIG_FREERTOS_USE_TRACE_FACILITY=y
CONFIG_FREERTOS_USE_STATS_FORMATTING_FUNCTIONS=y
CONFIG_FREERTOS_VTASKLIST_INCLUDE_COREID=y
#
# Core dumps:
#
CONFIG_ESP_COREDUMP_ENABLE_TO_FLASH=y
CONFIG_ESP_COREDUMP_DATA_FORMAT_ELF=y
CONFIG_ESP_COREDUMP_CHECKSUM_CRC32=y
CONFIG_ESP_COREDUMP_CHECK_BOOT=y
CONFIG_ESP_COREDUMP_ENABLE=y
CONFIG_ESP_COREDUMP_LOGS=y
CONFIG_ESP_COREDUMP_MAX_TASKS_NUM=64
CONFIG_ESP_COREDUMP_STACK_SIZE=0
CONFIG_ESP_COREDUMP_CAPTURE_DRAM=y
#
# Heap debugging - only enable if needed
#
# CONFIG_HEAP_TASK_TRACKING=y
# CONFIG_HEAP_POISONING_COMPREHENSIVE=y
# CONFIG_ESP_INT_WDT_TIMEOUT_MS=5000
# CONFIG_FREERTOS_USE_LIST_DATA_INTEGRITY_CHECK_BYTES=y
```
